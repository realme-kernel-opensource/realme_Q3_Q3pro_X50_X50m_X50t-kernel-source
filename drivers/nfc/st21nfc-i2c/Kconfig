## drivers/nfc/st21nfc-i2c/Kconfig
```kconfig
config NFC_ST21_DEVICES
	bool "ST Microelectronics ST21NFC NFC Controller Driver"
	depends on I2C
	default y
	---help---
     ST Microelectronics ST21NFC Near Field Communication controller
     support.
```
